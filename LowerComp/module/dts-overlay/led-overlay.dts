 /dts-v1/;
 /plugin/;

 #include "../imx6ul-pinfunc.h"
 #include "dt-bindings/gpio/gpio.h"

 / {
        fragment@0 {
            target-path = "/";
            __overlay__ {
                	rgb_led{
		                #address-cells = <1>;
		                #size-cells = <1>;
		                pinctrl-names = "default";
		                compatible = "fire,rgb-led";
		                pinctrl-0 = <&pinctrl_rgb_led>;
		                rgb_led_red = <&gpio1 4 GPIO_ACTIVE_LOW>;
		                rgb_led_green = <&gpio4 20 GPIO_ACTIVE_LOW>;
		                rgb_led_blue = <&gpio4 19 GPIO_ACTIVE_LOW>;
		                statue = "okay";
	                };
            };
        };

        fragment@1 {
            target= <&iomuxc>;
            __overlay__{
				pinctrl_rgb_led:rgb_led{
					fsl,pins = <
					MX6UL_PAD_GPIO1_IO04__GPIO1_IO04		0x000010B1
					MX6UL_PAD_CSI_HSYNC__GPIO4_IO20		    0x000010B1
					MX6UL_PAD_CSI_VSYNC__GPIO4_IO19		    0x000010B1
					>;
				};
            };
        };
 };



